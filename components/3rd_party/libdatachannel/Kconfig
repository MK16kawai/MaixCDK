## components/3rd_party/libdatachannel/Kconfig
```kconfig
menu "libdatachannel component configuration"
    menu "LIBDATACHANNEL version"
        config LIBDATACHANNEL_VERSION_MAJOR
            int "LIBDATACHANNEL version major"
            default 0 if PLATFORM = "maixcam"
            default 0 if PLATFORM = "maixcam2"
            default 0
        config LIBDATACHANNEL_VERSION_MINOR
            int "LIBDATACHANNEL version minor"
            default 24 if PLATFORM = "maixcam"
            default 24 if PLATFORM = "maixcam2"
            default 24
        config LIBDATACHANNEL_VERSION_PATCH
            int "LIBDATACHANNEL version patch"
            default 0 if PLATFORM = "maixcam"
            default 0 if PLATFORM = "maixcam2"
            default 0
    endmenu
endmenu
```

## components/3rd_party/libjuice/Kconfig
```kconfig
menu "libjuice component configuration"
    menu "LIBJUICE version"
        config LIBJUICE_VERSION_MAJOR
            int "LIBJUICE version major"
            default 1 if PLATFORM = "maixcam"
            default 1 if PLATFORM = "maixcam2"
            default 1
        config LIBJUICE_VERSION_MINOR
            int "LIBJUICE version minor"
            default 7 if PLATFORM = "maixcam"
            default 7 if PLATFORM = "maixcam2"
            default 7
        config LIBJUICE_VERSION_PATCH
            int "LIBJUICE version patch"
            default 0 if PLATFORM = "maixcam"
            default 0 if PLATFORM = "maixcam2"
            default 0
    endmenu
endmenu
```

## components/3rd_party/uchardet/Kconfig
```kconfig
# uchardet version major minor patch
menu "uchardet version"
config UCHARDET_VERSION_MAJOR
    int "uchardet package major version"
    default 0
    help
      uchardet package major version, 0 means auto select according to board

config UCHARDET_VERSION_MINOR
    int "uchardet package minor version"
    default 0
    help
      uchardet package minor version

config UCHARDET_VERSION_PATCH
    int "uchardet package patch version"
    default 5
    help
      uchardet package patch version
endmenu
```
